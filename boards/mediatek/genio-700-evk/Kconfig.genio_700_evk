## boards/mediatek/genio-700-evk/Kconfig.genio_700_evk
```kconfig
# Copyright 2025 MediaTek
# SPDX-License-Identifier: Apache-2.0

config BOARD_GENIO_700_EVK
	select SOC_MT8390_A55 if BOARD_GENIO_700_EVK_MT8390_A55
```

## boards/mediatek/genio-700-evk/board.yml
```yaml
board:
  name: genio_700_evk
  full_name: GENION 700 EVK (4*Cortex-A55 and 4*Cortex-A78)
  vendor: mediatek
  socs:
  - name: mt8390
```

## boards/mediatek/mt8370-genio-510-evk/board.yml
```yaml
board:
  name: mt8370_genio_510_evk
  full_name: MT8370 GENIO 510 EVK (4*Cortex-A55 and 2*Cortex-A78)
  vendor: mediatek
  socs:
  - name: mt8188
```

## boards/mediatek/mt8390-genio-700-evk/board.yml
```yaml
board:
  name: mt8390_genio_700_evk
  full_name: MT8390 GENIO 700 EVK (4*Cortex-A55 and 4*Cortex-A78)
  vendor: mediatek
  socs:
  - name: mt8188
```

## drivers/clock_control/Kconfig.mtk_clk
```kconfig
# Copyright 2026 MediaTek
# SPDX-License-Identifier: Apache-2.0

config CLOCK_CONTROL_MT8188
	bool "MT8188 clock control driver"
	default y
	depends on CLOCK_CONTROL
	depends on DT_HAS_MEDIATEK_MT8188_CLK_INFRA_A0_ENABLED
	help
	  Enable support for MediaTek MT8188 clock control driver.
```

## drivers/dma/Kconfig.mtk
```kconfig
# Copyright (c) 2025 MASSDRIVER EI <massdriver.space>
# SPDX-License-Identifier: Apache-2.0

config DMA_MTK_MEMIF
	bool "Mediatek Audio Front End MEMIF DMA driver"
	default y
	depends on DT_HAS_MEDIATEK_MEMIF_ENABLED
	help
	  AFE MEMIF DMA driver for Mediatek SoCs
```

## drivers/gpio/Kconfig.mtk_gpio
```kconfig
# MediaTek GPIO configuration options
# Copyright (c) 2025, MediaTek
# SPDX-License-Identifier: Apache-2.0

config GPIO_MT8365
	bool "MediaTek MT8365 GPIO driver"
	default y
	depends on SOC_MT8365
	depends on DT_HAS_MEDIATEK_MT8365_GPIO_ENABLED
	select PINCTRL
	help
	  Enable the MediaTek MT8365 GPIO driver.

config GPIO_MT8370
	bool "MediaTek MT8370 GPIO driver"
	default y
	depends on SOC_MT8370
	depends on DT_HAS_MEDIATEK_MT8188_GPIO_ENABLED
	select PINCTRL
	help
	  Enable the MediaTek MT8370 GPIO driver.

config GPIO_MT8188
	bool "MediaTek MT8188 GPIO driver"
	default y
	depends on SOC_MT8188_A55
	depends on DT_HAS_MEDIATEK_MT8188_GPIO_ENABLED
	select PINCTRL
	help
	  Enable the MediaTek MT8188 GPIO driver.
```

## drivers/pinctrl/Kconfig.mtk_pinctrl
```kconfig
# MediaTek PINCTRL
# Copyright (c) 2025, MediaTek
# SPDX-License-Identifier: Apache-2.0

config PINCTRL_MT8365
	bool "MediaTek MT8365 PINCTRL driver"
	default y
	depends on SOC_MT8365
    depends on DT_HAS_MEDIATEK_MT8365_PINCTRL_ENABLED
	help
	  Enable the MediaTek MT8365 PINCTRL driver

config PINCTRL_MT8188
	bool "MediaTek MT8188 PINCTRL driver"
	default y
	depends on SOC_MT8188_A55
    depends on DT_HAS_MEDIATEK_MT8188_PINCTRL_ENABLED
	help
	  Enable the MediaTek MT8188 PINCTRL driver.
```

## drivers/serial/Kconfig.mtk_uart
```kconfig
# MediaTek UART
# Copyright (c) 2025, MediaTek
# SPDX-License-Identifier: Apache-2.0

config UART_MT8365
	bool "MediaTek MT8365 UART driver"
	default y
	depends on SOC_MT8365
	depends on DT_HAS_MEDIATEK_MT8365_UART_ENABLED
	select PINCTRL
	select SERIAL_HAS_DRIVER
	select SERIAL_SUPPORT_INTERRUPT
	help
	  Enable the MediaTek MT8365 UART driver.

config UART_MT8188
	bool "MediaTek MT8188 UART driver"
	default y
	depends on SOC_MT8188_A55
	depends on DT_HAS_MEDIATEK_MT8188_UART_ENABLED
	select PINCTRL
	select SERIAL_HAS_DRIVER
	select SERIAL_SUPPORT_INTERRUPT
	help
	  Enable the MediaTek MT8188 UART driver.
```

## dts/bindings/clock/mediatek,mt8188-apmixedsys.yaml
```yaml
# Copyright (c) 2026, MediaTek
# SPDX-License-Identifier: Apache-2.0

description: MediaTek MT8188 APMIXEDSYS PLL clock controller

compatible: "mediatek,mt8188-apmixedsys"

include: [clock-controller.yaml, base.yaml]

properties:
  "#clock-cells":
    const: 1

clock-cells:
  - name
```

## dts/bindings/clock/mediatek,mt8188-topckgen.yaml
```yaml
# Copyright (c) 2026, MediaTek
# SPDX-License-Identifier: Apache-2.0

description: MediaTek MT8188 TOPCKGEN mux+gate clock controller

compatible: "mediatek,mt8188-topckgen"

include: [clock-controller.yaml, base.yaml]

properties:
  "#clock-cells":
    const: 1

clock-cells:
  - name
```

## dts/bindings/clock/mediatek,mt8188_clk_infra_a0.yaml
```yaml
# Copyright (c) 2026, MediaTek
# SPDX-License-Identifier: Apache-2.0

description: MediaTek INFRA-A0 clock controller

compatible: "mediatek,mt8188-clk_infra_a0"

include: [clock-controller.yaml, base.yaml]

properties:
  "#clock-cells":
    const: 1

clock-cells:
  - name
```

## dts/bindings/gpio/mediatek,mt8390-gpio.yaml
```yaml
# Copyright (c) 2025 MediaTek
# SPDX-License-Identifier: Apache-2.0

description: MT8390 GPIO

compatible: "mediatek,mt8390-gpio"

include: [gpio-controller.yaml, base.yaml]

properties:
  reg:
    required: true

  pinmux:
    type: phandles

  "#gpio-cells":
    const: 2

gpio-cells:
  - pin
  - flags
```

## soc/mediatek/mt8390/a55/Kconfig.soc
```kconfig
# Copyright 2025 MediaTek
# SPDX-License-Identifier: Apache-2.0

config SOC_SERIES_MT8390
	bool
	select SOC_FAMILY_MTK_GENIO

config SOC_SERIES
	default "mt8390" if SOC_SERIES_MT8390

config SOC_MT8390
	bool
	select SOC_SERIES_MT8390

config SOC_MT8390_A55
	bool
	select SOC_MT8390
	help
	  MTK MT8390 A55

config SOC_MT8390_A55
	bool
	select SOC_MT8390
	help
	  MTK MT8390 A55

config SOC
	default "mt8390" if SOC_MT8390

config SOC_PART_NUMBER_MT8390
	bool

config SOC_PART_NUMBER
	default "mt8390" if SOC_PART_NUMBER_MT8390
```

## soc/mediatek/mt8xxx/mt8188/Kconfig.soc
```kconfig
# Copyright 2024 The ChromiumOS Authors
# SPDX-License-Identifier: Apache-2.0

config SOC_MT8188
	bool
	select SOC_SERIES_MT818X

config SOC_MT8188_ADSP
	bool
	select SOC_MT8188
	select SOC_MTK_ADSP_CLUSTER
	help
	  MediaTek MT8188 audio DSP

config SOC_MT8188_A55
	bool
	select SOC_MT8188
	select SOC_MTK_ARM_CLUSTER
	help
	  MediaTek MT8188 Cortex-A55 cluster

config SOC
	default "mt8188" if SOC_MT8188

config SOC_MTK_CLUSTER_SUBDIR
	default "a55" if SOC_MT8188_A55
```

## soc/mediatek/mt8xxx/mt8195/Kconfig.defconfig_adsp
```kconfig
# Copyright 2023 The ChromiumOS Authors
# SPDX-License-Identifier: Apache-2.0

if SOC_MT8195_ADSP

config NUM_2ND_LEVEL_AGGREGATORS
	default 2
config 2ND_LVL_INTR_00_OFFSET
	default 1
config 2ND_LVL_INTR_01_OFFSET
	default 23

config XTENSA_CCOUNT_HZ
	default 720000000

config SOC_TOOLCHAIN_NAME
	default "mtk_mt8195_adsp"

endif # SOC_MT8195_ADSP
```

## soc/mediatek/mt8xxx/mt8365/Kconfig.defconfig_a53
```kconfig
# Copyright 2025 MediaTek
# SPDX-License-Identifier: Apache-2.0

if SOC_MT8365_A53

config NUM_IRQS
	default 240

endif
```

## soc/mediatek/mt8xxx/mt8365/Kconfig.soc
```kconfig
# Copyright 2025 MediaTek
# SPDX-License-Identifier: Apache-2.0

config SOC_MT8365
	bool
	select SOC_SERIES_MT8365

config SOC_MT8365_A53
	bool
	select SOC_MT8365
	select SOC_MTK_ARM_CLUSTER
	help
	  MediaTek MT8365 Cortex-A53 cluster

config SOC
	default "mt8365" if SOC_MT8365

config SOC_MTK_CLUSTER_SUBDIR
	default "a53" if SOC_MT8365_A53
```
